/* Tiny Graphics Library using TinyI2C library - see http://www.technoblogy.com/show?23OS

   David Johnson-Davies - www.technoblogy.com - 16th February 2022
   
   CC BY 4.0
   Licensed under a Creative Commons Attribution 4.0 International license: 
   http://creativecommons.org/licenses/by/4.0/
*/

#include <TinyI2CMaster.h>

// OLED display **********************************************

// Constants
int const address = 60;
int const commands = 0x00;
int const onecommand = 0x80;
int const data = 0x40;
int const onedata = 0xC0;

// Character set for text - stored in program memory
const uint8_t CharMap[96][6] PROGMEM = {
{ 0x00, 0x00, 0x00, 0x00, 0x00, 0x00 }, 
{ 0x00, 0x00, 0x5F, 0x00, 0x00, 0x00 }, 
{ 0x00, 0x07, 0x00, 0x07, 0x00, 0x00 }, 
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{ 0xFF, 0xFF, 0xFF, 0xFF, 0xFF, 0x00 }

};

// Current plot position
int x0;
int y0;

// Write a single command
void Single (uint8_t x) {
  TinyI2C.write(onecommand);
  TinyI2C.write(x);
}
  
void InitDisplay () {
  TinyI2C.start(address, 0);
  TinyI2C.write(commands);
  TinyI2C.write(0xA1);  // Flip horizontal
  TinyI2C.write(0xAF);  // Display on
  TinyI2C.stop();
}

void ClearDisplay () {
  for (int p = 0 ; p < 8; p++) {
    TinyI2C.start(address, 0);
    Single(0xB0 + p);
    TinyI2C.write(data);
    for (int q = 0 ; q < 132; q++) TinyI2C.write(0);
    TinyI2C.stop();
  }
}

// Plot point x,y into buffer if in current slice
void PlotPoint (int x, int y) {
  TinyI2C.start(address, 0);
  Single(0x00 + ((x + 2) & 0x0F));        // Column low nibble
  Single(0x10 + ((x + 2)>>4));            // Column high nibble
  Single(0xB0 + (y>>3));                  // Page
  Single(0xE0);                           // Read modify write
  TinyI2C.write(onedata);
  TinyI2C.restart(address, 2);
  TinyI2C.read();                         // Dummy read
  int j = TinyI2C.read();
  TinyI2C.restart(address, 0);
  TinyI2C.write(onedata);
  TinyI2C.write((1<<(y & 0x07)) | j);
  Single(0xEE);                           // Cancel read modify write
  TinyI2C.stop();
}

// Move current plot position to x,y
void MoveTo (int x, int y) {
  x0 = x;
  y0 = y;
}

// Draw a line to x,y
void DrawTo (int x, int y) {
  int sx, sy, e2, err;
  int dx = abs(x - x0);
  int dy = abs(y - y0);
  if (x0 < x) sx = 1; else sx = -1;
  if (y0 < y) sy = 1; else sy = -1;
  err = dx - dy;
  for (;;) {
    PlotPoint(x0, y0);
    if (x0==x && y0==y) return;
    e2 = err<<1;
    if (e2 > -dy) { err = err - dy; x0 = x0 + sx; }
    if (e2 < dx) { err = err + dx; y0 = y0 + sy; }
  }
}

uint8_t ReverseByte (uint8_t x) {
  x = (x>>1 & 0x55) | (x<<1 & 0xaa);
  x = (x>>2 & 0x33) | (x<<2 & 0xcc);
  x = (x>>4 & 0x0f) | (x<<4 & 0xf0);
  return x;    
}

// Plot an ASCII character with bottom left corner at x,y
void PlotChar (int c, int x, int y) {
  int h = y & 0x07;
  for (int p = 0; p < 2; p++) {
    TinyI2C.start(address, 0);            // Write
    Single(0xB0 + (y>>3) + p);            // Page
    for (int col=0; col<6; col++) {
      Single(0x00 + ((x+2+col) & 0x0F));  // Column low nibble
      Single(0x10 + ((x+2+col)>>4));      // Column high nibble
      Single(0xE0);                       // Read modify write
      TinyI2C.write(onedata);
      TinyI2C.restart(address, 2);
      TinyI2C.read();                     // Dummy read
      int j = TinyI2C.read();
      TinyI2C.restart(address, 0);
      TinyI2C.write(onedata);
      int bits = ReverseByte(pgm_read_byte(&CharMap[c-32][col]));
      TinyI2C.write((bits<<h)>>(p<<3) | j);
      Single(0xEE);                       // Cancel read modify write
    }
  TinyI2C.stop();
  }
}

// Plot text starting at the current plot position
void PlotText(PGM_P s) {
  int p = (int)s;
  while (1) {
    char c = pgm_read_byte(p++);
    if (c == 0) return;
    PlotChar(c, x0, y0);
    x0 = x0 + 6;
  }
}

// Setup **********************************************

void setup() {
  analogReference(INTERNAL1V1);
  TinyI2C.init();
  ClearDisplay();
  InitDisplay();
}

const int Now = 1234;                     // To set the time; eg 12:34
unsigned long StartMins = (unsigned long)((Now/100)*60 + (Now%100));


void loop () {
  unsigned int SampleNo = StartMins/15;
  // Plot temperature graph
  int x1 = 16, y1 = 11;
  int yscale = 2;                         // Points per degree
  MoveTo(26, 56); PlotText(PSTR("Temperature ~C"));
  // Horizontal axis
  MoveTo(x1, y1); DrawTo(x1+96, y1);
  for (int i=0; i<=24; i=i+4) {
    int mark = x1+i*4;
    MoveTo(mark, y1); DrawTo(mark, y1-2);
    int tens = i/10;
    if (tens != 0) {
      PlotChar(tens+'0', mark-6, y1-12);
      PlotChar(i%10+'0', mark, y1-12);
    } else PlotChar(i%10+'0', mark-3, y1-12);
  }
  // Vertical axis
  MoveTo(x1, y1); DrawTo(x1, y1+50);
  for (int i=5; i<=25; i=i+5) {
    int mark = y1+i*yscale-10;
    MoveTo(x1, mark); DrawTo(x1-2, mark);
    int tens = i/10;
    if (tens != 0) PlotChar(tens+'0', x1-15, mark-3);
    PlotChar(i%10+'0', x1-9, mark-3);
  }
  for (;;) {
    // Now start plotting the temperature every 15 mins
    while ((unsigned long) ((StartMins + millis()/60000)/15)%96 == SampleNo);
    // Time to take a new reading
    SampleNo = (SampleNo+1)%96;
    int Temperature = (analogRead(A0)*25)/233;  // In half degrees 
    PlotPoint(SampleNo+x1, Temperature-10+y1);
  }
}
